## meta-container-os/conf/distro/qbee-cos.conf
```bitbake
# Distro Layer configuration
# include and overwrite default poky distro
include conf/distro/poky.conf
DISTRO = "qbee-cos"
DISTRO_NAME = "Qbee Container OS"
#DISTRO_VERSION = "1.0"
DISTRO_CODENAME = "scarthgap"
SDK_VENDOR = "-qbeecossdk"
SDK_VERSION="${DISTRO_VERSION}"
MAINTAINER = "contact@qbee.io"

TARGET_VENDOR = "-qbee"
INIT_MANAGER = "systemd"

DISTRO_FEATURES:append = " rauc tpm tpm2 virtualization seccomp ipv6"
MACHINE_FEATURES:append = " tpm2"
IMAGE_INSTALL:append = " rauc packagegroup-security-tpm2 docker-moby docker-compose parted grow-data-part"

PACKAGECONFIG:remove:pn-rauc = "service"

RAUC_SLOT_rootfs[fstype] = "ext4"
RAUC_SLOT_rootfs[adaptive] = "block-hash-index"
RAUC_BUNDLE_VERSION:forcevariable = "${DISTRO_VERSION}"
RAUC_BUNDLE_DESCRIPTION:forcevariable = "Qbee Container OS ${DISTRO_VERSION}"

DISTRO_CHANGELOG_PATH = "${COREBASE}/meta-container-os/files/changelog.txt"

# 2. Define the namespace globally. 
# Using '?=' allows a specific bundle recipe to override it if ever needed.
RAUC_META_SECTIONS ?= "release_info"

# 3. Securely inject the file contents only into RAUC bundles
python () {
    # CRITICAL: Only run this I/O logic if the recipe inherits bundle.bbclass.
    # Without this check, BitBake will read the file thousands of times during parsing!
    if bb.data.inherits_class('bundle', d):
        import os
        
        # Expand the global variable to get the absolute path
        changelog_path = d.expand(d.getVar('DISTRO_CHANGELOG_PATH'))
        
        # Tell BitBake to track this file as a dependency.
        # If changelog.txt changes, BitBake will know to rebuild the bundle.
        bb.parse.mark_dependency(d, changelog_path)
        
        # Read and sanitize the file for the INI-style manifest
        if os.path.exists(changelog_path):
            with open(changelog_path, 'r') as f:
                # Replace actual newlines with literal '\n' characters
                changelog_content = f.read().strip().replace('\n', ' \\n ')
        else:
            # exit hard if the changelog is missing, since it's critical metadata for the release
            bb.fatal(f"Changelog file not found at {changelog_path}. This file is required for building RAUC bundles and must be present.")
            
        # Inject the parsed text into the RAUC flag
        d.setVarFlag('RAUC_META_release_info', 'changelog', changelog_content)
}

RAUC_META_release_info[ticket] = "NOJIRA-${DISTRO_VERSION}"
RAUC_META_release_info[author] = "qbee.io"

WKS_FILE:forcevariable = "qbee-cos-${MACHINE}.wks"
WIC_CREATE_EXTRA_ARGS = "--no-fstab-update"
```

## meta-container-os/conf/layer.conf
```bitbake
# We have a conf and classes directory, add to BBPATH
BBPATH .= ":${LAYERDIR}"

# We have recipes-* directories, add to BBFILES
BBFILES += "${LAYERDIR}/recipes-*/*/*.bb \
            ${LAYERDIR}/recipes-*/*/*.bbappend"

BBFILE_COLLECTIONS += "meta-container-os"
BBFILE_PATTERN_meta-container-os = "^${LAYERDIR}/"
BBFILE_PRIORITY_meta-container-os = "20"

LAYERDEPENDS_meta-container-os = "core"
LAYERSERIES_COMPAT_meta-container-os = "scarthgap"

BBFILES_DYNAMIC += " \
  meta-rauc-raspberrypi:${LAYERDIR}/dynamic-layers/raspberrypi/*/*/*.bb \
  meta-rauc-raspberrypi:${LAYERDIR}/dynamic-layers/raspberrypi/*/*/*.bbappend \
  meta-rauc-qemux86:${LAYERDIR}/dynamic-layers/qemux86/*/*/*.bb \
  meta-rauc-qemux86:${LAYERDIR}/dynamic-layers/qemux86/*/*/*.bbappend \
"
```

## meta-container-os/wic/qbee-cos-beaglebone-yocto.wks
```
part /boot --source bootimg-partition --ondisk mmcblk0 --fstype=vfat --label boot --active --align 4 --fixed-size 32 --sourceparams="loader=u-boot" --use-uuid
part / --source rootfs --fixed-size 1024M --ondisk mmcblk0 --fstype=ext4 --label rootfs_A --align 4096 --use-uuid
part / --source rootfs --fixed-size 1024M --ondisk mmcblk0 --fstype=ext4 --label rootfs_B --align 4096 --use-uuid
part /data --size 10 --ondisk mmcblk0 --fstype=ext4 --label data --align 4096 --fsoptions "x-systemd.growfs"
bootloader --append="console=ttyS0,115200"
```

## meta-container-os/wic/qbee-cos-raspberrypi.wks
```
part /boot --source bootimg-partition --ondisk mmcblk0 --fstype=vfat --label boot --active --align 4096 --size 100
part / --source rootfs --fixed-size 1024M --ondisk mmcblk0 --fstype=ext4 --label rootfs_A --align 4096 
part / --source rootfs --fixed-size 1024M --ondisk mmcblk0 --fstype=ext4 --label rootfs_B --align 4096
part /data --size 10 --ondisk mmcblk0 --fstype=ext4 --label data --align 4096 --fsoptions "x-systemd.growfs"
```

## meta-qbee/conf/layer.conf
```bitbake
# We have a conf and classes directory, add to BBPATH
BBPATH .= ":${LAYERDIR}"

# We have recipes-* directories, add to BBFILES
BBFILES += "${LAYERDIR}/recipes-*/*/*.bb \
            ${LAYERDIR}/recipes-*/*.bbappend"

BBFILE_COLLECTIONS += "meta-qbee"
BBFILE_PATTERN_meta-qbee = "^${LAYERDIR}/"
BBFILE_PRIORITY_meta-qbee = "5"

LAYERDEPENDS_meta-qbee = "core"
LAYERSERIES_COMPAT_meta-qbee = "styhead scarthgap nanbield mickledore langdale kirkstone"
PREFERRED_RPROVIDER_sshd = "openssh"
GOVERSION ?= "1.24%"

export GOPROXY ??= "https://proxy.golang.org,direct"

# fixup 6ad90f backport and remove the linkmode
# https://git.openembedded.org/openembedded-core/commit/?id=6ad90fc2fc49c4199a59dfb1c1d81a7ba184a522
#GO_LINKMODE:remove = "--linkmode=external"
```
