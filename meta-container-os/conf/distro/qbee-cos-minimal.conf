## meta-container-os/conf/distro/qbee-cos-minimal.conf
```bitbake
# Distro Layer configuration
# include and overwrite default poky distro
include conf/distro/poky.conf
DISTRO = "qbee-cos"
DISTRO_NAME = "Qbee Container OS"
#DISTRO_VERSION = "1.0"
DISTRO_CODENAME = "wrynose"
SDK_VENDOR = "-qbeecossdk"
SDK_VERSION = "${DISTRO_VERSION}"
MAINTAINER = "contact@qbee.io"

TARGET_VENDOR = "-qbee"
INIT_MANAGER = "systemd"

DISTRO_FEATURES:append = " rauc tpm tpm2 virtualization seccomp ipv6"
MACHINE_FEATURES:append = " tpm2"
QBEE_AUTO_INSTALL = "0"
IMAGE_INSTALL:append = " qbee-agent rauc podman packagegroup-security-tpm2 parted grow-data-part"

PACKAGECONFIG:remove:pn-rauc = "service"

RAUC_SLOT_rootfs[fstype] = "ext4"
RAUC_SLOT_rootfs[adaptive] = "block-hash-index"
```
